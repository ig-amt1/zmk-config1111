## config/boards/shields/2keys/Kconfig.shield
```kconfig
config SHIELD_2KEYS_LEFT
    def_bool $(shields_list_contains,2keys_left)

config SHIELD_2KEYS_RIGHT
    def_bool $(shields_list_contains,2keys_right)
```

## config/boards/shields/TD34/Kconfig.shield
```kconfig
config SHIELD_MY_BOARD_LEFT
    def_bool $(shields_list_contains,TD34_left)

config SHIELD_MY_BOARD_RIGHT
    def_bool $(shields_list_contains,TD34_right)
```

## config/boards/shields/reset/Kconfig.defconfig
```kconfig
# Copyright (c) 2020 The ZMK Contributors
# SPDX-License-Identifier: MIT

if SHIELD_RESET

config ZMK_KEYBOARD_NAME
	default "SETTINGS RESET"

endif
```

## config/boards/shields/reset/Kconfig.shield
```kconfig
# Copyright (c) 2020 The ZMK Contributors
# SPDX-License-Identifier: MIT

config SHIELD_RESET
	def_bool $(shields_list_contains,reset)
```

## config/boards/shields/td34/Kconfig.shield
```kconfig
config SHIELD_MY_BOARD_LEFT
    def_bool $(shields_list_contains,td34_left)

config SHIELD_MY_BOARD_RIGHT
    def_bool $(shields_list_contains,td34_right)
```
